&mdss_mdp {
	dsi_himax_hx8874_12p3_dev1_dsc_cmd: qcom,mdss_dsi_himax_hx8874_12p3_dev1_dsc_cmd {
        qcom,mdss-dsi-panel-name = "HX8874 165hz cmd mode panel with DSC";
		qcom,mdss-dsi-panel-type = "dsi_cmd_mode";
		qcom,dsi-ctrl-num = <0 1>;
		qcom,dsi-phy-num = <0 1>;
		qcom,mdss-dsi-panel-physical-type = "oled";
		qcom,mdss-dsi-virtual-channel-id = <0>;
		qcom,mdss-dsi-stream = <0>;
		qcom,mdss-dsi-bpp = <24>;
		qcom,mdss-dsi-color-order = "rgb_swap_rgb";
		qcom,mdss-dsi-underflow-color = <0xff>;
		qcom,mdss-dsi-border-color = <0>;
		qcom,mdss-dsi-traffic-mode = "burst_mode";
		qcom,mdss-dsi-lane-map = "lane_map_0123";
		qcom,mdss-dsi-bllp-eof-power-mode;
		qcom,mdss-dsi-bllp-power-mode;
		qcom,mdss-dsi-lane-0-state;
		qcom,mdss-dsi-lane-1-state;
		qcom,mdss-dsi-lane-2-state;
		qcom,mdss-dsi-lane-3-state;
		qcom,mdss-dsi-lp11-init;
		qcom,mdss-dsi-tx-eot-append;
		qcom,mdss-dsi-dma-trigger = "trigger_sw";
		qcom,mdss-dsi-mdp-trigger = "none";
		qcom,mdss-dsi-reset-sequence = <1 10>, <0 10>, <1 20>;
		qcom,mdss-dsi-te-pin-select = <1>;
		qcom,mdss-dsi-te-dcs-command = <1>;
		qcom,mdss-dsi-te-check-enable;
		qcom,mdss-dsi-te-using-te-pin;
		qcom,mdss-dsi-bl-min-level = <1>;
		qcom,mdss-dsi-bl-max-level = <4095>;
		qcom,mdss-dsi-bl-pmic-control-type = "bl_ctrl_dcs";
		qcom,mdss-dsi-panel-hdr-enabled;
		qcom,mdss-dsi-panel-hdr-color-primaries = <14500 15500 34015
			15980 13030 34670 6950 2565>;
		qcom,mdss-dsi-panel-peak-brightness = <6680000>;
		qcom,mdss-dsi-panel-blackness-level = <20>;
		qcom,mdss-pan-physical-width-dimension = <72>;
		qcom,mdss-pan-physical-height-dimension = <158>;
		qcom,bl-dcs-cmd-state = "dsi_lp_mode";
		qcom,bl-dsc-cmd-state = "dsi_lp_mode";
		qcom,mdss-dsi-display-timings {
			timing@0 {
				cell-index = <0>;
				qcom,mdss-dsi-panel-width = <1500>; // 3000/2
				qcom,mdss-dsi-panel-height = <1920>;
                qcom,mdss-dsi-h-pulse-width = <8>;
                qcom,mdss-dsi-h-back-porch = <336>;
                qcom,mdss-dsi-h-front-porch = <300>;
                qcom,mdss-dsi-h-sync-skew = <0>;
                qcom,mdss-dsi-v-pulse-width = <8>;
                qcom,mdss-dsi-v-back-porch = <12>;
                qcom,mdss-dsi-v-front-porch = <12>;
                qcom,mdss-dsi-h-left-border = <0>;
                qcom,mdss-dsi-h-right-border = <0>;
                qcom,mdss-dsi-v-top-border = <0>;
				qcom,mdss-dsi-v-bottom-border = <0>;
				qcom,mdss-dsi-panel-framerate = <60>;
				/*qcom,mdss-mdp-transfer-time-us = <6235>;*/
				/*qcom,mdss-dsi-panel-clockrate = <1060499680>;*/
				qcom,mdss-dsi-panel-clockrate = <9170600000>;

				qcom,mdss-dsi-on-command = [
					29 01 00 00 00 00 09 80 0c 00 88 e6 0e 3a 38 0d
					29 01 00 00 00 00 09 80 0c 01 b5 e7 00 00 00 00
					29 01 00 00 00 00 09 80 44 00 88 e6 19 17 00 00
					29 01 00 00 00 00 09 80 54 00 88 e6 19 17 00 00
					29 01 00 00 00 00 09 80 00 03 b6 e7 02 00 40 01
					29 01 00 00 00 00 09 80 20 03 b6 e7 02 00 40 01
					23 01 00 00 00 00 02 87 01
					05 01 00 00 f0 00 01 11
					39 01 00 00 f0 00 03 51 00 00
					29 01 00 00 00 00 05 2a 00 00 05 db
					29 01 00 00 00 00 05 2b 00 00 07 7f
					05 01 00 00 00 00 01 29
					29 01 00 00 00 00 09 80 8c 00 80 e7 f0 1f 01 00
					29 01 00 00 00 00 09 80 8c 00 80 e7 00 00 00 00
					39 01 00 00 00 00 03 51 07 f0
				];
				qcom,mdss-dsi-on-command-state = "dsi_lp_mode";
				qcom,mdss-dsi-off-command = [
					29 01 00 00 00 00 09 80 20 00 B5 e7 00 00 00 00
					29 01 00 00 00 00 09 80 28 00 B5 e7 00 00 00 00
					29 01 00 00 00 00 09 80 30 00 B5 e7 00 00 00 00
					29 01 00 00 00 00 09 80 38 00 B5 e7 00 00 00 00
					29 01 00 00 00 00 09 80 3C 00 B5 e7 00 00 00 00
					05 01 00 00 64 00 02 28 00
					05 01 00 00 64 00 02 10 00
				];
				qcom,mdss-dsi-off-command-state = "dsi_lp_mode";

				qcom,compression-mode = "dsc";
				qcom,mdss-dsc-version = <0x11>;
				qcom,mdss-dsc-scr-version = <0x0>;
				qcom,mdss-dsc-slice-height = <4>;
				qcom,mdss-dsc-slice-width = <750>;
				qcom,mdss-dsc-slice-per-pkt = <2>;
				qcom,mdss-dsc-bit-per-component = <10>;
				qcom,mdss-dsc-bit-per-pixel = <8>;
				qcom,mdss-dsc-block-prediction-enable;
			};
		};
	};
};
&dsi_himax_hx8874_12p3_dev1_dsc_cmd {
	qcom,panel-supply-entries = <&dsi_panel_pwr_supply_qvkino>;
	qcom,mdss-dsi-bl-pmic-control-type = "bl_ctrl_dcs";
	qcom,mdss-brightness-max-level = <8191>;
	qcom,mdss-dsi-bl-inverted-dbv;
	qcom,platform-reset-gpio = <&tlmm 98 0>;
	qcom,ulps-enabled;
	qcom,dsi-select-clocks = "pll_byte_clk0", "pll_dsi_clk0";

	qcom,mdss-dsi-display-timings {
			timing@0 {
				qcom,mdss-dsi-panel-phy-timings = [00 1F 08 07 18 22 08
						08 08 02 04 00 1A 1D];
				qcom,display-topology = <2 2 2>;
				qcom,default-topology-index = <0>;
		};
	};
};
