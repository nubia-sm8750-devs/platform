// SPDX-License-Identifier: BSD-3-Clause
/*
 * Copyright (c) 2023-2024 Qualcomm Innovation Center, Inc. All rights reserved.
 */

/dts-v1/;
/plugin/;
#define ZTE_DISP_QVCORK
#include "sun-sde-display-mtp-nfc-overlay.dts"
#include "sun-sde-display-qvcork.dtsi"
/ {
	model = "Qualcomm Technologies, Inc. Sun MTP, zte board qvcork";
	qcom,board-id = <0x30008 0>;
};
