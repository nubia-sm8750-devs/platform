/dts-v1/;
/plugin/;

#include "../zte-sun-common-overlay.dtsi"
#include "zte-qvkino-overlay.dtsi"

/ {
	model = "Qualcomm Technologies, Inc. SunP QRD HDK, zte board qvkino";
	compatible = "qcom,sunp-hdk", "qcom,sunp", "qcom,hdk";
	qcom,msm-id = <639 0x10000>, <639 0x20000>, <618 0x10000>, <618 0x20000>,
			<0x100026a 0x10000>, <0x100026a 0x20000>,
			<0x100027f 0x10000>, <0x100027f 0x20000>;
	qcom,board-id = <0x1001f 0>;
};
