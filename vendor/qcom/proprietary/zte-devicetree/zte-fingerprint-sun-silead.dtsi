&soc {
	silead_fp {
		status = "ok";
		compatible = "sil,silead_fp";
		qcom,qup-id = <3>;
		reg = <0>;
		avdd-gpios = <&tlmm 214 0x1>;
		irq-gpios = <&tlmm 99 0x2008>;
		rst-gpios = <&tlmm 78 0x1>;
 		panel = <&dsi_bf288_rm692h5_6p85_dsc_cmd>;
 		panel_2nd = <&dsi_bf289_rm692h5_sec_422p_cmd
			     &dsi_nt35695b_truly_fhd_video>;
	};
};