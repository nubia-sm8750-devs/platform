## kernel_platform/msm-kernel/drivers/nfc/fm19511/Kconfig
```kconfig
#
# fm19511 nfc tag driver configuration
#

config NFC_TAG_FM19511
	tristate "ST NCI based NFC Driver for ST54J"
	depends on I2C && SPI
	help
	  This enables the NFC driver for ST54J based devices.
	  This is for i2c connected with NFC controller and spi connected
	  with eSE.NCI protocol logic resides in the usermode and it has
	  no other NFC dependencies.
```

## kernel_platform/msm-kernel/drivers/vendor/common/micropump/Kconfig
```kconfig
#
# micro pump driver configuration
#
choice
	prompt "select a micro pump driver"

config BOS1921_MICRO_PUMP
	tristate "bos1921 micropump"
    help
        Say m here if you use bos1921 control micropump.

config AW86320_MICRO_PUMP
	tristate "aw86320 micropump"
    help
        Say m here if you use aw86320 control micropump.
endchoice
```

## kernel_platform/msm-kernel/drivers/vendor/common/tfa98xx/Kconfig
```kconfig
config SND_SOC_TFA98XX
  bool "Support Goodix smartpa driver"

config SND_SOC_TFA98XX_SINGLE
  bool "Support Goodix smartpa driver"

config SND_SOC_TFA98XX_DOUBLE
  bool "Support Goodix double smartpa driver"

config SND_SOC_TFA98XX_Z9900S
  bool "Support Z9900S special i2c-2 sound card"
```

## kernel_platform/msm-kernel/drivers/vendor/common/touchscreen_v2/hxchipset/Kconfig
```kconfig
# SPDX-License-Identifier: GPL-2.0-only
#
# Himax Touchscreen driver configuration
#

menuconfig TOUCHSCREEN_HIMAX_HX83122A_LBP
	tristate "Goodix berlin touchscreen"
	default n
	help
 	  Say Y here, and a list of supported touchscreens will be displayed.
	  This option doesn't affect the kernel.

	  If unsure, say N.

if TOUCHSCREEN_HIMAX_HX83122A_LBP

config TOUCHSCREEN_HIMAX_CHIPSET
	bool "Himax touchpanel CHIPSET"
	depends on TOUCHSCREEN_HIMAX_HX83122A_LBP
	help
	  Say Y here if you have a Himax CHIPSET touchscreen.
	  HIMAX controllers are multi touch controllers which can
	  report 10 touches at a time.

          If unsure, say N.

config TOUCHSCREEN_HIMAX_COMMON
 	tristate "HIMAX chipset touchscreen"
 	depends on TOUCHSCREEN_HIMAX_HX83122A_LBP
 	help
 	  This enables support for HIMAX CHIPSET touchscreens.

          If unsure, say N.

config TOUCHSCREEN_HIMAX_IC_HX85200A
 	tristate "HIMAX chipset HX85200A function"
 	depends on TOUCHSCREEN_HIMAX_HX83122A_LBP
 	help
 	  This enables support for HIMAX CHIPSET of HX85200A.

          If unsure, say N.

config TOUCHSCREEN_HIMAX_DEBUG
 	bool "HIMAX debug function"
 	depends on TOUCHSCREEN_HIMAX_HX83122A_LBP
 	help
 	  This enables support for HIMAX debug function.

          If unsure, say N.

config TOUCHSCREEN_HIMAX_INSPECT
 	bool "HIMAX inspect function"
 	depends on TOUCHSCREEN_HIMAX_HX83122A_LBP
 	help
 	  This enables support for HIMAX inspect function.

          If unsure, say N.

config TOUCHSCREEN_HIMAX_EMBEDDED_FIRMWARE
	bool "HIMAX embedded firmware function"
	depends on TOUCHSCREEN_HIMAX_CHIPSET
	help
		This enables built-in FW inside kernel as binary array

config HMX_DB
	bool "HIMAX driver test over Dragon Board"
	depends on TOUCHSCREEN_HIMAX_CHIPSET
	help
		This enables support for HIMAX driver test over Dragon Board.

config HIMAX_SUPPORT_KERNEL_419
    bool "HIMAX support kernel 4.19"
	depends on TOUCHSCREEN_HIMAX_CHIPSET
	help
		This enables support for support kernel 4.19.

endif
```

## kernel_platform/msm-kernel/drivers/vendor/soc/qcom/ifas_inner/Kconfig
```kconfig
config VENDOR_ZTE_IFAS_INNER
	tristate "ZTE IFAS POLICY"
	default n
	help
	  Say 'y' here to include support for zte ifas.
```

## kernel_platform/msm-kernel/drivers/vendor/soc/qcom/satel_hd/Kconfig
```kconfig
# SPDX-License-Identifier: GPL-2.0-only
#
# Misc strange devices
#


config ZTE_HD_SATEL
	tristate "zte drivers for hdbd Satellite control"
	default n
	help
		zte poweron driver for hdbd Satellite control

config ZTE_HD_SATEL_RF
	tristate "zte rf driver for hdbd Satellite rf control"
	default n
	help
		zte rf driver for hdbd Satellite rf control

config ZTE_HD6180
	tristate "zte poweron driver for hd6180 beidou message control"
	default n
	help
		zte poweron driver for hd6180 beidou message control

config ZTE_HD8040
	tristate "zte poweron driver for hd8040 beidou location control"
	default n
	help
		zte poweron driver for hd8040 beidou location control
```

## kernel_platform/msm-kernel/drivers/vendor/soc/qcom/zte_rpcom/Kconfig
```kconfig
# SPDX-License-Identifier: GPL-2.0-only
#
# Misc strange devices
#


config ZTE_RPCOM
	tristate "zte poweron driver for rpcom control"
	help
		zte poweron driver for rpcom control

config ZTE_RPCOM_RF_LDO
	tristate "rpcom rf ctrl, using LDO as trx power-supply, instead of pm"
	default n
	help
		rpcom rf ctrl using LDO as trx power-supply

config ZTE_RPCOM_2UIMPLUG
	tristate "rpcom uim 2hotplug"
	default n
	help
		rpcom uim 2hotplug, using 2 independent uim card
```
